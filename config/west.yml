## config/west.yml
```yaml
manifest:
  remotes:
    - name: zmkfirmware
      url-base: https://github.com/zmkfirmware
  projects:
    - name: zmk
      remote: zmkfirmware
      # Pin to a stable release to avoid breaking changes on main.
      revision: v0.2
      import: app/west.yml
  self:
    path: config
```
